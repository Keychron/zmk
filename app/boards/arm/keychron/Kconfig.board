## app/boards/arm/keychron/Kconfig.board
```kconfig
# Copyright (c) 2023 The ZMK Contributors
# SPDX-License-Identifier: MIT

config BOARD_KEYCHRON
    bool "keychron"
    depends on SOC_NRF52840_QIAA
```

## app/boards/arm/keychron/Kconfig.defconfig
```kconfig
# Copyright (c) 2023 The ZMK Contributors
# SPDX-License-Identifier: MIT

if BOARD_KEYCHRON

config ZMK_KEYBOARD_NAME
    default "Keychron B6 Pro"

if USB_DEVICE_STACK

config USB_NRFX
    default y

endif # USB_DEVICE_STACK

config BT_CTLR
    default BT

config ZMK_BLE
    default y

config ZMK_USB
    default y

config ZMK_LEDS_GPIO 
    bool "enable gpio leds"
    default y
    select LED

config ZMK_LEDS_PWM
    bool "enable pwm leds"
    default n 
    select PWM
    select LED_PWM

endif # BOARD_KEYCHRON
```

## app/boards/arm/keychron/keychron_defconfig
```kconfig
# Copyright (c) 2021 Nick Winans
# SPDX-License-Identifier: MIT

CONFIG_SOC_SERIES_NRF52X=y
CONFIG_SOC_NRF52840_QIAA=y
CONFIG_BOARD_KEYCHRON=y

# Enable MPU
CONFIG_ARM_MPU=y

CONFIG_PINCTRL=y

# enable GPIO
CONFIG_GPIO=y

# Enable i2c
CONFIG_I2C=n

CONFIG_USE_DT_CODE_PARTITION=y
CONFIG_BUILD_OUTPUT_UF2=y

CONFIG_MPU_ALLOW_FLASH_WRITE=y
CONFIG_NVS=y
CONFIG_SETTINGS_NVS=y
CONFIG_FLASH=y
CONFIG_FLASH_PAGE_LAYOUT=y
CONFIG_FLASH_MAP=y

# CONFIG_ZMK_RTT_LOGGING=y
# CONFIG_ZMK_USB_LOGGING=y
#CONFIG_ZMK_UART_LOGGING=y

# RGB
# Uncomment these to enable RGB underglow
# CONFIG_CKLED2001=n
#CONFIG_ZMK_RGB_UNDERGLOW=n
#CONFIG_ZMK_RGB_UNDERGLOW_EXT_POWER=n
#CONFIG_ZMK_RGB_UNDERGLOW_EFF_START=3
#CONFIG_ZMK_RGB_UNDERGLOW_BRT_START=10
#CONFIG_ZMK_RGB_UNDERGLOW_HUE_START=100
#CONFIG_ZMK_RGB_UNDERGLOW_ON_START=n 

CONFIG_BT_ID_MAX=5
CONFIG_BT_SMP_ALLOW_UNAUTH_OVERWRITE=y
# CONFIG_BT_ID_UNPAIR_MATCHING_BONDS=y
CONFIG_BT_FILTER_ACCEPT_LIST=y
CONFIG_BT_PRIVACY=n 
CONFIG_BT_CTLR_PRIVACY=y

# CONFIG_ZMK_HID_REPORT_TYPE_NKRO=y
CONFIG_ZMK_HID_CONSUMER_REPORT_USAGES_FULL=y

#CONFIG_USB_HID_LOG_LEVEL_DBG=y
#CONFIG_USB_DEVICE_LOG_LEVEL_DBG=y


#CONFIG_ZERO_LATENCY_IRQS=y
CONFIG_DYNAMIC_INTERRUPTS=y
CONFIG_DYNAMIC_DIRECT_INTERRUPTS=y



CONFIG_GPIO_AS_PINRESET=n
# Clock Source
CONFIG_CLOCK_CONTROL_NRF_K32SRC_RC=y
CONFIG_CLOCK_CONTROL_NRF_K32SRC_XTAL=n
CONFIG_CLOCK_CONTROL_NRF_K32SRC_RC_CALIBRATION=y

CONFIG_ZMK_EXT_POWER=n

#CONFIG_ZMK_KSCAN_MATRIX_POLLING=y

#CONFIG_ZMK_KSCAN_MATRIX_WAIT_BETWEEN_OUTPUTS=10
#CONFIG_ZMK_KSCAN_MATRIX_WAIT_BEFORE_INPUTS=10

CONFIG_ZMK_BLE_THREAD_PRIORITY=-1


CONFIG_ZMK_NRF_24G_ECB=y



CONFIG_ZMK_KSCAN_EVENT_QUEUE_SIZE=32
CONFIG_ZMK_BLE_KEYBOARD_REPORT_QUEUE_SIZE=64

CONFIG_USB_DEVICE_PRODUCT="Keychron B6 Pro"
CONFIG_USB_DEVICE_MANUFACTURER="Keychron"
CONFIG_USB_DEVICE_VID=0x3434
CONFIG_USB_DEVICE_PID=0x0761

CONFIG_BT_DIS_PNP_VID=0x3434
CONFIG_BT_DIS_PNP_PID=0x0761
CONFIG_BT_DIS_MODEL="Keychron B6 Pro"
CONFIG_BT_DIS_MANUF="Keychron"
CONFIG_BT_DIS_SETTINGS=y
CONFIG_BT_DIS_FW_REV=y
CONFIG_BT_DIS_HW_REV=y
CONFIG_BT_DIS_SERIAL_NUMBER=y
CONFIG_BT_DIS_FW_REV_STR="v1.2.9"
CONFIG_BT_DIS_HW_REV_STR="v1.0.0"
CONFIG_BT_DIS_SERIAL_NUMBER_STR="SN2024013114230078"

CONFIG_ZMK_SLEEP=y
CONFIG_ZMK_IDLE_SLEEP_TIMEOUT=7200000


#CONFIG_USB_DRIVER_LOG_LEVEL_DBG=y
#CONFIG_USB_DEVICE_LOG_LEVEL_DBG=y

CONFIG_USB_HID_BOOT_PROTOCOL=y
CONFIG_USB_HID_DEVICE_COUNT=2
CONFIG_ENABLE_HID_INT_OUT_EP=y
CONFIG_HID_INTERRUPT_EP_MPS=32
CONFIG_USB_DEVICE_SOF=y


CONFIG_RING_BUFFER=y
#disable ble 2M
CONFIG_BT_CTLR_PHY_2M=n
CONFIG_BT_GAP_AUTO_UPDATE_CONN_PARAMS=n
CONFIG_BT_KEYS_OVERWRITE_OLDEST=y

CONFIG_BT_CONN_TX_MAX=8
```

## app/boards/shields/keychron/b1/jis/Kconfig.shield
```kconfig
# Copyright (c) 2024 Keychron
# SPDX-License-Identifier: MIT



config SHIELD_KEYCHRON_B1
    bool    

config SHIELD_KEYCHRON_B1_JIS
    def_bool $(shields_list_contains,keychron_b1_jis)
    select SHIELD_KEYCHRON_B1
```

## app/boards/shields/keychron/b1/uk/Kconfig.shield
```kconfig
# Copyright (c) 2024 Keychron
# SPDX-License-Identifier: MIT



config SHIELD_KEYCHRON_B1
    bool    

config SHIELD_KEYCHRON_B1_UK
    def_bool $(shields_list_contains,keychron_b1_uk)
    select SHIELD_KEYCHRON_B1
```

## app/boards/shields/keychron/b1/us/Kconfig.shield
```kconfig
# Copyright (c) 2024 Keychron
# SPDX-License-Identifier: MIT



config SHIELD_KEYCHRON_B1
    bool    

config SHIELD_KEYCHRON_B1_US
    def_bool $(shields_list_contains,keychron_b1_us)
    select SHIELD_KEYCHRON_B1
```

## app/boards/shields/keychron/b2/jis/Kconfig.shield
```kconfig
# Copyright (c) 2024 Keychron
# SPDX-License-Identifier: MIT



config SHIELD_KEYCHRON_B2
    bool    

config SHIELD_KEYCHRON_B2_JIS
    def_bool $(shields_list_contains,keychron_b2_jis)
    select SHIELD_KEYCHRON_B2
```

## app/boards/shields/keychron/b2/kr/Kconfig.shield
```kconfig
# Copyright (c) 2024 Keychron
# SPDX-License-Identifier: MIT



config SHIELD_KEYCHRON_B2
    bool    

config SHIELD_KEYCHRON_B2_KR
    def_bool $(shields_list_contains,keychron_b2_kr)
    select SHIELD_KEYCHRON_B2
```

## app/boards/shields/keychron/b2/uk/Kconfig.shield
```kconfig
# Copyright (c) 2024 Keychron
# SPDX-License-Identifier: MIT



config SHIELD_KEYCHRON_B2
    bool    

config SHIELD_KEYCHRON_B2_UK
    def_bool $(shields_list_contains,keychron_b2_uk)
    select SHIELD_KEYCHRON_B2
```

## app/boards/shields/keychron/b6/uk/Kconfig.shield
```kconfig
# Copyright (c) 2024 Keychron
# SPDX-License-Identifier: MIT



config SHIELD_KEYCHRON_B6_UK
    def_bool $(shields_list_contains,keychron_b6_uk)
```
