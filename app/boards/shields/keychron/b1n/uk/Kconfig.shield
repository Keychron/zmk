## app/boards/shields/keychron/b1n/uk/Kconfig.shield
```kconfig
# Copyright (c) 2024 Keychron
# SPDX-License-Identifier: MIT

config ADAPATIVE_NKRO
   bool 

config EN_FIX_CAPS_ALT_DEL
    bool

config SHIELD_KEYCHRON_B1
    bool    

config SHIELD_KEYCHRON_B1_UK_N
    def_bool $(shields_list_contains,keychron_b1_ukn)
    select SHIELD_KEYCHRON_B1
    select ADAPATIVE_NKRO
    select EN_FIX_CAPS_ALT_DEL
```

## app/boards/shields/keychron/b1n/us/Kconfig.shield
```kconfig
# Copyright (c) 2024 Keychron
# SPDX-License-Identifier: MIT

config ADAPATIVE_NKRO
   bool 

config EN_FIX_CAPS_ALT_DEL
    bool

config SHIELD_KEYCHRON_B1
    bool    

config SHIELD_KEYCHRON_B1_US_N
    def_bool $(shields_list_contains,keychron_b1_usn)
    select SHIELD_KEYCHRON_B1
    select ADAPATIVE_NKRO
    select EN_FIX_CAPS_ALT_DEL
```

## app/boards/shields/keychron/b2n/jis/Kconfig.shield
```kconfig
# Copyright (c) 2024 Keychron
# SPDX-License-Identifier: MIT

config ADAPATIVE_NKRO
   bool 

config EN_FIX_CAPS_ALT_DEL
    bool

config SHIELD_KEYCHRON_B2
    bool    

config SHIELD_KEYCHRON_B2_JIS_N
    def_bool $(shields_list_contains,keychron_b2_jisn)
    select SHIELD_KEYCHRON_B2
    select ADAPATIVE_NKRO
    select EN_FIX_CAPS_ALT_DEL
```

## app/boards/shields/keychron/b2n/kr/Kconfig.shield
```kconfig
# Copyright (c) 2024 Keychron
# SPDX-License-Identifier: MIT

config ADAPATIVE_NKRO
   bool 

config SHIELD_KEYCHRON_B2
    bool    

config SHIELD_KEYCHRON_B2_KR_N
    def_bool $(shields_list_contains,keychron_b2_krn)
    select SHIELD_KEYCHRON_B2
    select ADAPATIVE_NKRO
```

## app/boards/shields/keychron/b6n/jis/Kconfig.shield
```kconfig
# Copyright (c) 2024 Keychron
# SPDX-License-Identifier: NIT

config ADAPATIVE_NKRO
   bool 

config EN_FIX_CAPS_ALT_DEL
    bool

config SHIELD_KEYCHRON_B6_JIS_N
    def_bool $(shields_list_contains,keychron_b6_jisn)
    select ADAPATIVE_NKRO
    select EN_FIX_CAPS_ALT_DEL
```

## app/boards/shields/keychron/b6n/uk/Kconfig.shield
```kconfig
# Copyright (c) 2024 Keychron
# SPDX-License-Identifier: MIT

config ADAPATIVE_NKRO
   bool 

config EN_FIX_CAPS_ALT_DEL
    bool

config SHIELD_KEYCHRON_B6_UK_N
    def_bool $(shields_list_contains,keychron_b6_ukn)
    select ADAPATIVE_NKRO
    select EN_FIX_CAPS_ALT_DEL
```

## app/boards/shields/keychron/b6n/us/Kconfig.shield
```kconfig
# Copyright (c) 2024 Keychron
# SPDX-License-Identifier: MIT

config ADAPATIVE_NKRO
   bool 

config EN_FIX_CAPS_ALT_DEL
    bool

config SHIELD_KEYCHRON_B6_US_N
    def_bool $(shields_list_contains,keychron_b6_usn)
    select ADAPATIVE_NKRO
    select EN_FIX_CAPS_ALT_DEL
```

## app/boards/shields/keychron_k1_ultra_ansi/Kconfig.shield
```kconfig
# Copyright (c) 2024
# SPDX-License-Identifier: MIT

config SHIELD_KEYCHRON_K1_ULTRA_ANSI
    def_bool $(shields_list_contains,keychron_k1_ultra_ansi)
    select SHIELD_KEYCHRON_V1MAX  
    select KEYCHRON_RGB_ENABLE
    select SNAP_CLICK_ENABLE
    select RETAIL_DEMO_ENABLE
    select ADAPATIVE_NKRO
    select MAC_VIA_FUNC
    # select FAST_KSCAN
    select ADD_PPT_REPORT_RATE
    select ENABLE_GPIO_LED
    # select ENABLE_WIN_LOCK
    # select ENABLE_WIN_LOCK_INDICATOR
    select DEFAULT_1K_REPORT_RATE
    select ENABLE_FLASH_PROTECT
```

## app/boards/shields/keychron_k5_ultra_ansi/Kconfig.shield
```kconfig
# Copyright (c) 2024
# SPDX-License-Identifier: MIT

config SHIELD_KEYCHRON_K5_ULTRA_ANSI
    def_bool $(shields_list_contains,keychron_k5_ultra_ansi)
    select SHIELD_KEYCHRON_V1MAX  
    select KEYCHRON_RGB_ENABLE
    select SNAP_CLICK_ENABLE
    select RETAIL_DEMO_ENABLE
    select ADAPATIVE_NKRO
    select MAC_VIA_FUNC
    # select FAST_KSCAN
    select ADD_PPT_REPORT_RATE
    select ENABLE_GPIO_LED
    # select ENABLE_WIN_LOCK
    # select ENABLE_WIN_LOCK_INDICATOR
    select LED_595_OUTPUT
    # select COL_595_OUTPUT
    # select COL_595_AND_GPIOS_OUTPUT
    select DEFAULT_1K_REPORT_RATE
    select ENABLE_FLASH_PROTECT
```

## app/boards/shields/keychron_q1_ultra_iso/Kconfig.shield
```kconfig
# Copyright (c) 2024
# SPDX-License-Identifier: MIT

config SHIELD_KEYCHRON_Q1_ULTRA_ISO
    def_bool $(shields_list_contains,keychron_q1_ultra_iso)
    select SHIELD_KEYCHRON_V1MAX  
    select KEYCHRON_RGB_ENABLE
    select SNAP_CLICK_ENABLE
    select RETAIL_DEMO_ENABLE
    select ADAPATIVE_NKRO
    select MAC_VIA_FUNC
    # select FAST_KSCAN
    select ADD_PPT_REPORT_RATE
    select ENABLE_GPIO_LED
    select ENABLE_FLASH_PROTECT
    select DEFAULT_1K_REPORT_RATE
```

## app/boards/shields/keychron_q6_ultra_jis/Kconfig.shield
```kconfig
# Copyright (c) 2024
# SPDX-License-Identifier: MIT

config SHIELD_KEYCHRON_Q6_ULTRA_JIS
    def_bool $(shields_list_contains,keychron_q6_ultra_jis)
    select SHIELD_KEYCHRON_V1MAX  
    select KEYCHRON_RGB_ENABLE
    select SNAP_CLICK_ENABLE
    select RETAIL_DEMO_ENABLE
    select ADAPATIVE_NKRO
    select MAC_VIA_FUNC
    # select FAST_KSCAN
    select ADD_PPT_REPORT_RATE
    select ENABLE_GPIO_LED
    select ENABLE_FLASH_PROTECT
    select DEFAULT_1K_REPORT_RATE
```

## app/boards/shields/keychron_qn104_ansi/Kconfig.shield
```kconfig
# Copyright (c) 2024
# SPDX-License-Identifier: MIT

config SHIELD_KEYCHRON_QN104_ANSI
    def_bool $(shields_list_contains,keychron_qn104_ansi)
    select SHIELD_KEYCHRON_V1MAX  
    select ENABLE_GPIO_LED
    select ENABLE_WIN_LOCK
    select ENABLE_WIN_LOCK_INDICATOR
    select ENABLE_NKRO_LED_FLASH
    select KEYCHRON_RGB_ENABLE
    select SNAP_CLICK_ENABLE
    select RETAIL_DEMO_ENABLE
    select SOFTWARE_SWITCH_LAYER
    select MAC_VIA_FUNC
    select ENABLE_FLASH_PROTECT
```

## app/boards/shields/keychron_rs45_ansi/Kconfig.shield
```kconfig
# Copyright (c) 2024
# SPDX-License-Identifier: MIT

config SHIELD_KEYCHRON_RS45_ANSI
    def_bool $(shields_list_contains,keychron_rs45_ansi)
    select SHIELD_KEYCHRON_V1MAX    
    select ENABLE_WIN_LOCK
    select ENABLE_WIN_LOCK_INDICATOR
    select ENABLE_NKRO_LED_FLASH
    select KEYCHRON_RGB_ENABLE
    select SNAP_CLICK_ENABLE
    select RETAIL_DEMO_ENABLE
    select ENABLE_FLASH_PROTECT
```

## app/boards/shields/keychron_rs87_ansi/Kconfig.shield
```kconfig
# Copyright (c) 2024
# SPDX-License-Identifier: MIT

config SHIELD_KEYCHRON_RS87_ANSI
    def_bool $(shields_list_contains,keychron_rs87_ansi)
    select SHIELD_KEYCHRON_V1MAX  
    select ENABLE_GPIO_LED
    select ENABLE_WIN_LOCK
    select ENABLE_WIN_LOCK_INDICATOR
    select ENABLE_NKRO_LED_FLASH
    select KEYCHRON_RGB_ENABLE
    select SNAP_CLICK_ENABLE
    select RETAIL_DEMO_ENABLE
    select SOFTWARE_SWITCH_LAYER
    select MAC_VIA_FUNC
    select CHANGE_REPORT_RATE
    select FAST_KSCAN
    select ADD_PPT_REPORT_RATE
    select ENABLE_FLASH_PROTECT
```

## app/boards/shields/keychron_v5_ultra_iso/Kconfig.shield
```kconfig
# Copyright (c) 2024
# SPDX-License-Identifier: MIT

config SHIELD_KEYCHRON_V5_ULTRA_ISO
    def_bool $(shields_list_contains,keychron_v5_ultra_iso)
    select SHIELD_KEYCHRON_V1MAX  
    select KEYCHRON_RGB_ENABLE
    select SNAP_CLICK_ENABLE
    select RETAIL_DEMO_ENABLE
    # select FAST_KSCAN
    select ADD_PPT_REPORT_RATE
    select ENABLE_GPIO_LED
    select DEFAULT_1K_REPORT_RATE
    select ENABLE_FLASH_PROTECT
    select ADAPATIVE_NKRO
```

## app/boards/shields/keychron_v6_ultra_jis/Kconfig.shield
```kconfig
# Copyright (c) 2024
# SPDX-License-Identifier: MIT

config SHIELD_KEYCHRON_V6_ULTRA_JIS
    def_bool $(shields_list_contains,keychron_v6_ultra_jis)
    select SHIELD_KEYCHRON_V1MAX  
    select KEYCHRON_RGB_ENABLE
    select SNAP_CLICK_ENABLE
    select RETAIL_DEMO_ENABLE
    select MAC_VIA_FUNC
    # select FAST_KSCAN
    select ADD_PPT_REPORT_RATE    
    select ENABLE_GPIO_LED
    select DEFAULT_1K_REPORT_RATE
    select ENABLE_FLASH_PROTECT
    select ADAPATIVE_NKRO
```
